## components/board/Kconfig
```kconfig
menu "Desk Assistant board"

    config BOARD_DISPLAY_BUFFER_ROWS
        int "Rows per display draw buffer"
        range 2 480
        default 10
        help
            Height of each partial draw buffer. Must be even so updates stay on the
            panel's 2x2 grid.

    config BOARD_DISPLAY_BUFFER_COUNT
        int "Number of display draw buffers"
        range 1 2
        default 2
        help
            Two buffers let rendering overlap the transfer of the previous one.

    config BOARD_AUDIO_DMA_DESC_COUNT
        int "Audio capture DMA descriptors"
        range 2 16
        default 6
        help
            Each descriptor holds one block of 256 samples (16 ms at 16 kHz). They absorb
            the moments when flash writes pause the reading task.

    config BOARD_BATTERY_READ_PERIOD_S
        int "Battery reading period (seconds)"
        range 5 600
        default 30

    config BOARD_AUDIO_ACQUIRE_WAIT_MS
        int "Capture wait for a finishing tone in milliseconds"
        range 100 5000
        default 1000

    config BOARD_BATTERY_TASK_STACK_SIZE
        int "Battery task stack size (bytes)"
        range 1536 8192
        default 2048

    config BOARD_BATTERY_TASK_PRIORITY
        int "Battery task priority"
        range 1 10
        default 2

endmenu
```

## components/bridge/Kconfig
```kconfig
menu "Desk Assistant bridge"

    config BRIDGE_SNTP_SERVER
        string "SNTP server"
        default "pool.ntp.org"
        help
            Server for the test unit's automatic clock synchronization.

    config BRIDGE_STREAM_TASK_STACK_SIZE
        int "SSE task stack size (bytes)"
        range 6144 16384
        default 8192

    config BRIDGE_STREAM_TASK_PRIORITY
        int "SSE task priority"
        range 1 10
        default 4

    config BRIDGE_DIAGNOSTIC_PROBE
        bool "Run one read-only bridge memory probe after SSE opens"
        depends on DESK_MEMORY_DIAGNOSTICS
        default n
        help
            Performs one non-consuming event read on the first SSE connection.
            Records technical memory checkpoints without logging the response.

    config BRIDGE_DIAGNOSTIC_TASK_STACK_SIZE
        int "Bridge memory probe task stack size (bytes)"
        depends on BRIDGE_DIAGNOSTIC_PROBE
        range 6144 16384
        default 8192

    config BRIDGE_DIAGNOSTIC_TASK_PRIORITY
        int "Bridge memory probe task priority"
        depends on BRIDGE_DIAGNOSTIC_PROBE
        range 1 10
        default 3

endmenu
```

## components/connectivity/Kconfig
```kconfig
menu "Desk Assistant connectivity"

    config CONNECTIVITY_USB_TASK_STACK_SIZE
        int "USB provisioning task stack size (bytes)"
        range 2048 8192
        default 3584

    config CONNECTIVITY_USB_TASK_PRIORITY
        int "USB provisioning task priority"
        range 1 10
        default 2
        help
            Below the UI and storage tasks; a request is applied with synchronous NVS writes.

    config CONNECTIVITY_USB_RX_BUFFER_SIZE
        int "USB Serial/JTAG receive buffer (bytes)"
        range 256 4096
        default 1024

endmenu
```

## components/diagnostics/Kconfig
```kconfig
menu "Desk Assistant diagnostics"

    config DESK_MEMORY_DIAGNOSTICS
        bool "Log memory and stack usage at checkpoints"
        default y
        select FREERTOS_USE_TRACE_FACILITY
        help
            Logs the internal heap free size, minimum free size and largest
            free block, and the minimum free stack of every task, each time a
            checkpoint is reported.

endmenu
```

## components/features/modules/Kconfig
```kconfig
menu "Modules"
    config MODULES_WORKER_STACK_SIZE
        int "Module read worker stack bytes"
        default 8192
        range 4096 16384

    config MODULES_WORKER_PRIORITY
        int "Module read worker priority"
        default 3
        range 1 20
endmenu
```

## components/features/notifications/Kconfig
```kconfig
menu "Notifications"
    config NOTIFICATIONS_WORKER_STACK_SIZE
        int "Notification worker stack bytes"
        default 8192
        range 4096 16384

    config NOTIFICATIONS_WORKER_PRIORITY
        int "Notification worker priority"
        default 4
        range 1 20

    config NOTIFICATIONS_ACK_RETRY_MS
        int "Pending ACK retry delay in milliseconds"
        default 5000
        range 1000 60000

    config NOTIFICATIONS_SOUND_WORKER_STACK_SIZE
        int "Tone worker stack bytes"
        default 4096
        range 3072 8192

    config NOTIFICATIONS_SOUND_WORKER_PRIORITY
        int "Tone worker priority"
        default 4
        range 1 20

    config NOTIFICATIONS_SOUND_WAIT_MS
        int "Tone wait while audio is owned, in milliseconds"
        default 50
        range 10 500

    config NOTIFICATIONS_SOUND_CLEANUP_RETRY_MS
        int "Tone cleanup retry interval in milliseconds"
        default 500
        range 100 5000
endmenu
```

## components/features/recording/Kconfig
```kconfig
menu "Desk Assistant recording"

    config RECORDING_WORKER_STACK_SIZE
        int "Recording worker stack size (bytes)"
        range 3072 16384
        default 8192
        help
            The worker exists only while a job runs: cleanup, capture, upload, query or
            forget. Uploads and queries run the TLS handshake on this stack.

    config RECORDING_WORKER_PRIORITY
        int "Recording worker priority"
        range 1 20
        default 5
        help
            Above the UI and the event stream so I2S reads keep up with the microphone.

    config RECORDING_READ_TIMEOUT_MS
        int "Microphone block read timeout (ms)"
        range 20 1000
        default 100
        help
            A block arrives every 16 ms; a longer wait means the capture stalled.

    config RECORDING_WARMUP_MS
        int "Discarded audio at capture start (ms)"
        range 0 500
        default 100
        help
            The ADC output settles after power-up; this audio is read and dropped.

    config RECORDING_DURATION_GUARD_MS
        int "Capture wall-time margin over the maximum duration (ms)"
        range 500 10000
        default 2000
        help
            A capture still running after the maximum duration plus this margin is
            treated as interrupted.

endmenu
```

## components/storage/Kconfig
```kconfig
menu "Desk Assistant storage"

    config STORAGE_TASK_STACK_SIZE
        int "Storage task stack size (bytes)"
        range 2048 8192
        default 3072

    config STORAGE_TASK_PRIORITY
        int "Storage task priority"
        range 1 10
        default 3
        help
            Below the UI task, so a flash commit never delays drawing or input handling.

    config STORAGE_QUEUE_LENGTH
        int "Pending write requests"
        range 1 16
        default 4

endmenu
```

## components/ui/Kconfig
```kconfig
menu "Desk Assistant UI"

    config UI_TASK_STACK_SIZE
        int "UI task stack size (bytes)"
        range 4096 16384
        default 6144

    config UI_TASK_PRIORITY
        int "UI task priority"
        range 1 20
        default 4

    config UI_DIAGNOSTICS_PERIOD_S
        int "UI diagnostics period (seconds)"
        depends on DESK_MEMORY_DIAGNOSTICS
        range 10 3600
        default 60
        help
            Period of the UI report: task wakeups since the previous report, LVGL pool
            usage and the memory checkpoint.

endmenu
```

## sdkconfig.defaults
```kconfig
CONFIG_IDF_TARGET="esp32c6"
CONFIG_ESPTOOLPY_FLASHSIZE_16MB=y
CONFIG_PARTITION_TABLE_CUSTOM=y
CONFIG_PARTITION_TABLE_CUSTOM_FILENAME="partitions.csv"

CONFIG_ESP_CONSOLE_USB_SERIAL_JTAG=y
CONFIG_LOG_DEFAULT_LEVEL_INFO=y

CONFIG_MBEDTLS_CERTIFICATE_BUNDLE=y
CONFIG_MBEDTLS_CERTIFICATE_BUNDLE_DEFAULT_FULL=y
CONFIG_MBEDTLS_DYNAMIC_BUFFER=y
CONFIG_MBEDTLS_ASYMMETRIC_CONTENT_LEN=y
CONFIG_MBEDTLS_SSL_IN_CONTENT_LEN=16384
CONFIG_MBEDTLS_SSL_OUT_CONTENT_LEN=4096
CONFIG_ESP_HTTP_CLIENT_ENABLE_CUSTOM_TRANSPORT=y

# CONFIG_IEEE802154_ENABLED is not set

# LVGL: one owner task, built-in pool and only the fonts in use
CONFIG_LV_OS_NONE=y
CONFIG_LV_USE_BUILTIN_MALLOC=y
CONFIG_LV_MEM_SIZE_KILOBYTES=64
# CONFIG_LV_USE_THEME_DEFAULT is not set
# CONFIG_LV_FONT_MONTSERRAT_14 is not set
CONFIG_LV_FONT_MONTSERRAT_20=y
CONFIG_LV_FONT_MONTSERRAT_24=y
CONFIG_LV_FONT_MONTSERRAT_28=y
CONFIG_LV_FONT_DEFAULT_MONTSERRAT_24=y
# Without the period: amounts such as 1.250 stay on one line.
CONFIG_LV_TXT_BREAK_CHARS=" ,;:-_)}"
# CONFIG_LV_BUILD_EXAMPLES is not set
CONFIG_ESP_SYSTEM_EVENT_TASK_STACK_SIZE=4096
CONFIG_LV_USE_QRCODE=y
```
